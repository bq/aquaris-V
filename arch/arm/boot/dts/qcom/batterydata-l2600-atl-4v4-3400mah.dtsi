
qcom,3047977_longcheer_l2600atl_3400mah_averaged_masterslave_aug14th2017 {
	/* #3047977_Longcheer_L2600atl_3400mAh_averaged_MasterSlave_Aug14th2017*/
	qcom,max-voltage-uv = <4400000>;
	qcom,nom-batt-capacity-mah = <3400>;
	qcom,batt-id-kohm = <100>;
	qcom,battery-beta = <3435>;
	qcom,battery-type = "3047977_longcheer_l2600atl_3400mah_averaged_masterslave_aug14th2017";
	qcom,chg-rslow-comp-c1 = <3304030>;
	qcom,chg-rslow-comp-c2 = <4501854>;
	qcom,chg-rs-to-rslow = <1143583>;
	qcom,chg-rslow-comp-thr = <0xA2>;
	qcom,checksum = <0x632C>;
	qcom,gui-version = "PMI8950GUI - 2.0.0.16";
	qcom,fg-profile-data = [
		 F1 83 7E 7D 
		 BB 81 55 7C 
		 5C 83 DD 67 
		 22 83 79 8D 
		 3C 82 63 98 
		 B6 B5 01 C1 
		 58 15 16 88 
		 45 7F 02 83 
		 85 7D 4D 83 
		 62 70 9F 69 
		 26 7E 2E 82 
		 40 9A 99 BD 
		 F7 CA 60 0E 
		 46 0D 6D 59 
		 14 70 64 FD 
		 60 3C D2 44 
		 56 3A 00 00 
		 73 4C BB 33 
		 93 41 00 00 
		 00 00 00 00 
		 00 00 00 00 
		 C5 70 E0 6B 
		 05 70 84 89 
		 D6 74 C8 68 
		 C2 67 68 78 
		 A3 6E 32 61 
		 CC 5D 87 A2 
		 1E B6 63 20 
		 65 A0 71 0C 
		 28 00 FF 36 
		 F0 11 30 03 
		 00 00 00 0C 
	];
};
