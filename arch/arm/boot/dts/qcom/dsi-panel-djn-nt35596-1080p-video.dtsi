/* Copyright (c) 2013, The Linux Foundation. All rights reserved.
 *
 * This program is free software; you can redistribute it and/or modify
 * it under the terms of the GNU General Public License version 2 and
 * only version 2 as published by the Free Software Foundation.
 *
 * This program is distributed in the hope that it will be useful,
 * but WITHOUT ANY WARRANTY; without even the implied warranty of
 * MERCHANTABILITY or FITNESS FOR A PARTICULAR PURPOSE.  See the
 * GNU General Public License for more details.
 */

/*---------------------------------------------------------------------------
 * This file is autogenerated file using gcdb parser. Please do not edit it.
 * Update input XML file to add a new entry or update variable in this file
 * VERSION = "1.0"
 *---------------------------------------------------------------------------*/
&mdss_mdp {
	dsi_djn_nt35596_1080p_video: qcom,mdss_dsi_djn_nt35596_1080p_video{
		qcom,mdss-dsi-panel-name = "djn nt35596 1080p video mode dsi panel";
		qcom,mdss-dsi-panel-controller = <&mdss_dsi0>;
		qcom,mdss-dsi-panel-type = "dsi_video_mode";
		qcom,mdss-dsi-panel-destination = "display_1";
		qcom,mdss-dsi-panel-framerate = <60>;
		qcom,mdss-dsi-virtual-channel-id = <0>;
		qcom,mdss-dsi-stream = <0>;
		qcom,mdss-dsi-panel-width = <1080>;
		qcom,mdss-dsi-panel-height = <1920>;
		qcom,mdss-dsi-h-front-porch = <100>;
		qcom,mdss-dsi-h-back-porch = <94>;
		qcom,mdss-dsi-h-pulse-width = <2>;
		qcom,mdss-dsi-h-sync-skew = <0>;
		qcom,mdss-dsi-v-back-porch = <4>;
		qcom,mdss-dsi-v-front-porch = <4>;
		qcom,mdss-dsi-v-pulse-width = <2>;
		qcom,mdss-dsi-h-left-border = <0>;
		qcom,mdss-dsi-h-right-border = <0>;
		qcom,mdss-dsi-v-top-border = <0>;
		qcom,mdss-dsi-v-bottom-border = <0>;
		qcom,mdss-dsi-bpp = <24>;
		qcom,mdss-dsi-color-order = "rgb_swap_rgb";
		qcom,mdss-dsi-underflow-color = <0xff>;
		qcom,mdss-dsi-border-color = <0>;
		qcom,mdss-dsi-on-command = [
			39 01 00 00 00 00 02 FF EE                        
			39 01 00 00 0A 00 02 18 40                        
			39 01 00 00 14 00 02 18 00                        
			39 01 00 00 00 00 02 FF 05                        
			39 01 00 00 00 00 02 C5 31                        
			39 01 00 00 20 00 02 FB 01                        
			39 01 00 00 00 00 02 FF 01                        
			39 01 00 00 00 00 02 00 01                        
			39 01 00 00 00 00 02 01 55                        
			39 01 00 00 00 00 02 02 40                        
			39 01 00 00 00 00 02 05 50                        
			39 01 00 00 00 00 02 06 4A                        
			39 01 00 00 00 00 02 07 29                        
			39 01 00 00 00 00 02 08 0C                        
			39 01 00 00 00 00 02 0B 9B                        
			39 01 00 00 00 00 02 0C 9B                        
			39 01 00 00 00 00 02 0E B0                        
			39 01 00 00 00 00 02 0F B3                        
			//39 01 00 00 00 00 02 11 10                        
			//39 01 00 00 00 00 02 12 10                        
			39 01 00 00 00 00 02 13 03                        
			39 01 00 00 00 00 02 14 4A                        
			39 01 00 00 00 00 02 15 12                        
			39 01 00 00 00 00 02 16 12                        
			39 01 00 00 00 00 02 18 00                        
			39 01 00 00 00 00 02 19 77                        
			39 01 00 00 00 00 02 1A 55                        
			39 01 00 00 00 00 02 1B 13                        
			39 01 00 00 00 00 02 1C 00                        
			39 01 00 00 00 00 02 1D 00                        
			39 01 00 00 00 00 02 1E 00                        
			39 01 00 00 00 00 02 1F 00                        
			39 01 00 00 00 00 02 58 82                        
			39 01 00 00 00 00 02 59 02                        
			39 01 00 00 00 00 02 5A 02                        
			39 01 00 00 00 00 02 5B 02                        
			39 01 00 00 00 00 02 5C 82                        
			39 01 00 00 00 00 02 5D 82                        
			39 01 00 00 00 00 02 5E 02                        
			39 01 00 00 00 00 02 5F 02                        
			39 01 00 00 00 00 02 72 31                        
			39 01 00 00 00 00 02 FB 01                        
			39 01 00 00 00 00 02 FF 05                        
			39 01 00 00 00 00 02 00 01                        
			39 01 00 00 00 00 02 01 0B                        
			39 01 00 00 00 00 02 02 0C                        
			39 01 00 00 00 00 02 03 09                        
			39 01 00 00 00 00 02 04 0A                        
			39 01 00 00 00 00 02 05 1A                        
			39 01 00 00 00 00 02 06 10                        
			39 01 00 00 00 00 02 07 00                        
			39 01 00 00 00 00 02 08 1A                        
			39 01 00 00 00 00 02 09 00                        
			39 01 00 00 00 00 02 0A 00                        
			39 01 00 00 00 00 02 0B 00                        
			39 01 00 00 00 00 02 0C 00                        
			39 01 00 00 00 00 02 0D 13                        
			39 01 00 00 00 00 02 0E 15                        
			39 01 00 00 00 00 02 0F 17                        
			39 01 00 00 00 00 02 10 01                        
			39 01 00 00 00 00 02 11 0B                        
			39 01 00 00 00 00 02 12 0C                        
			39 01 00 00 00 00 02 13 09                        
			39 01 00 00 00 00 02 14 0A                        
			39 01 00 00 00 00 02 15 1A                        
			39 01 00 00 00 00 02 16 10                        
			39 01 00 00 00 00 02 17 10                        
			39 01 00 00 00 00 02 18 1A                        
			39 01 00 00 00 00 02 19 00                        
			39 01 00 00 00 00 02 1A 00                        
			39 01 00 00 00 00 02 1B 00                        
			39 01 00 00 00 00 02 1C 00                        
			39 01 00 00 00 00 02 1D 13                        
			39 01 00 00 00 00 02 1E 15                        
			39 01 00 00 00 00 02 1F 17                        
			39 01 00 00 00 00 02 20 00                        
			39 01 00 00 00 00 02 21 03                        
			39 01 00 00 00 00 02 22 01                        
			39 01 00 00 00 00 02 23 36                        
			39 01 00 00 00 00 02 24 36                        
			39 01 00 00 00 00 02 25 6D                        
			39 01 00 00 00 00 02 29 D8                        
			39 01 00 00 00 00 02 2A 2A                        
			39 01 00 00 00 00 02 2B 00                        
			39 01 00 00 00 00 02 B6 92                        
			39 01 00 00 00 00 02 B7 B4                        
			39 01 00 00 00 00 02 B8 05                        
			39 01 00 00 00 00 02 4B 04                        
			39 01 00 00 00 00 02 4C 12                        
			39 01 00 00 00 00 02 4D 00                        
			39 01 00 00 00 00 02 4E 22                        
			39 01 00 00 00 00 02 4F 22                        
			39 01 00 00 00 00 02 50 00                        
			39 01 00 00 00 00 02 51 61                        
			39 01 00 00 00 00 02 52 01                        
			39 01 00 00 00 00 02 53 01                        
			39 01 00 00 00 00 02 54 75                        
			39 01 00 00 00 00 02 55 6D                        
			39 01 00 00 00 00 02 5B 44                        
			39 01 00 00 00 00 02 5C 00                        
			39 01 00 00 00 00 02 5F 74                        
			39 01 00 00 00 00 02 60 75                        
			39 01 00 00 00 00 02 63 FF                        
			39 01 00 00 00 00 02 64 00                        
			39 01 00 00 00 00 02 67 04                        
			39 01 00 00 00 00 02 68 04                        
			39 01 00 00 00 00 02 6C 00                        
			39 01 00 00 00 00 02 7A 80                        
			39 01 00 00 00 00 02 7B A3                        
			39 01 00 00 00 00 02 7C D8                        
			39 01 00 00 00 00 02 7D 60                        
			39 01 00 00 00 00 02 7E 0A                        
			39 01 00 00 00 00 02 7F 1A                        
			39 01 00 00 00 00 02 80 00                        
			39 01 00 00 00 00 02 83 00                        
			39 01 00 00 00 00 02 93 08                        
			39 01 00 00 00 00 02 94 0A                        
			39 01 00 00 00 00 02 8A 33                        
			39 01 00 00 00 00 02 9B 0F                        
			39 01 00 00 00 00 02 A4 0F                        
			39 01 00 00 00 00 02 E7 80                        
			39 01 00 00 00 00 02 FB 01                        
			39 01 00 00 00 00 02 FF 01
			
			39 01 00 00 00 00 02 75 00//gama R+                       
			39 01 00 00 00 00 02 76 00                        
			39 01 00 00 00 00 02 77 00                        
			39 01 00 00 00 00 02 78 14                        
			39 01 00 00 00 00 02 79 00                        
			39 01 00 00 00 00 02 7A 3A                        
			39 01 00 00 00 00 02 7B 00                        
			39 01 00 00 00 00 02 7C 5A                        
			39 01 00 00 00 00 02 7D 00                        
			39 01 00 00 00 00 02 7E 74                        
			39 01 00 00 00 00 02 7F 00                        
			39 01 00 00 00 00 02 80 8B                        
			39 01 00 00 00 00 02 81 00                        
			39 01 00 00 00 00 02 82 9F                        
			39 01 00 00 00 00 02 83 00                        
			39 01 00 00 00 00 02 84 B1                        
			39 01 00 00 00 00 02 85 00                        
			39 01 00 00 00 00 02 86 C2                        
			39 01 00 00 00 00 02 87 00                        
			39 01 00 00 00 00 02 88 F7                        
			39 01 00 00 00 00 02 89 01                        
			39 01 00 00 00 00 02 8A 20                        
			39 01 00 00 00 00 02 8B 01                        
			39 01 00 00 00 00 02 8C 5C                        
			39 01 00 00 00 00 02 8D 01                        
			39 01 00 00 00 00 02 8E 89                        
			39 01 00 00 00 00 02 8F 01                        
			39 01 00 00 00 00 02 90 CB                        
			39 01 00 00 00 00 02 91 01                        
			39 01 00 00 00 00 02 92 FF                        
			39 01 00 00 00 00 02 93 02                        
			39 01 00 00 00 00 02 94 00                        
			39 01 00 00 00 00 02 95 02                        
			39 01 00 00 00 00 02 96 31                        
			39 01 00 00 00 00 02 97 02                        
			39 01 00 00 00 00 02 98 6F                        
			39 01 00 00 00 00 02 99 02                        
			39 01 00 00 00 00 02 9A 9A                        
			39 01 00 00 00 00 02 9B 02                        
			39 01 00 00 00 00 02 9C D4                        
			39 01 00 00 00 00 02 9D 02                        
			39 01 00 00 00 00 02 9E FB                        
			39 01 00 00 00 00 02 9F 03                        
			39 01 00 00 00 00 02 A0 2D                        
			39 01 00 00 00 00 02 A2 03                        
			39 01 00 00 00 00 02 A3 3C                        
			39 01 00 00 00 00 02 A4 03                        
			39 01 00 00 00 00 02 A5 4C                        
			39 01 00 00 00 00 02 A6 03                        
			39 01 00 00 00 00 02 A7 5E                        
			39 01 00 00 00 00 02 A9 03                        
			39 01 00 00 00 00 02 AA 71                        
			39 01 00 00 00 00 02 AB 03                        
			39 01 00 00 00 00 02 AC 89                        
			39 01 00 00 00 00 02 AD 03                        
			39 01 00 00 00 00 02 AE A5                        
			39 01 00 00 00 00 02 AF 03                        
			39 01 00 00 00 00 02 B0 D5                        
			39 01 00 00 00 00 02 B1 03                        
			39 01 00 00 00 00 02 B2 FF    
			
			39 01 00 00 00 00 02 B3 00//R- MRC                        
			39 01 00 00 00 00 02 B4 00                        
			39 01 00 00 00 00 02 B5 00                        
			39 01 00 00 00 00 02 B6 14                        
			39 01 00 00 00 00 02 B7 00                        
			39 01 00 00 00 00 02 B8 3A                        
			39 01 00 00 00 00 02 B9 00                        
			39 01 00 00 00 00 02 BA 5A                        
			39 01 00 00 00 00 02 BB 00                        
			39 01 00 00 00 00 02 BC 74                        
			39 01 00 00 00 00 02 BD 00                        
			39 01 00 00 00 00 02 BE 8B                        
			39 01 00 00 00 00 02 BF 00                        
			39 01 00 00 00 00 02 C0 9F                        
			39 01 00 00 00 00 02 C1 00                        
			39 01 00 00 00 00 02 C2 B1                        
			39 01 00 00 00 00 02 C3 00                        
			39 01 00 00 00 00 02 C4 C2                        
			39 01 00 00 00 00 02 C5 00                        
			39 01 00 00 00 00 02 C6 F7                        
			39 01 00 00 00 00 02 C7 01                        
			39 01 00 00 00 00 02 C8 20                        
			39 01 00 00 00 00 02 C9 01                        
			39 01 00 00 00 00 02 CA 5C                        
			39 01 00 00 00 00 02 CB 01                        
			39 01 00 00 00 00 02 CC 89                        
			39 01 00 00 00 00 02 CD 01                        
			39 01 00 00 00 00 02 CE CB                        
			39 01 00 00 00 00 02 CF 01                        
			39 01 00 00 00 00 02 D0 FF                        
			39 01 00 00 00 00 02 D1 02                        
			39 01 00 00 00 00 02 D2 00                        
			39 01 00 00 00 00 02 D3 02                        
			39 01 00 00 00 00 02 D4 31                        
			39 01 00 00 00 00 02 D5 02                        
			39 01 00 00 00 00 02 D6 6F                        
			39 01 00 00 00 00 02 D7 02                        
			39 01 00 00 00 00 02 D8 9A                        
			39 01 00 00 00 00 02 D9 02                        
			39 01 00 00 00 00 02 DA D4                        
			39 01 00 00 00 00 02 DB 02                        
			39 01 00 00 00 00 02 DC FB                        
			39 01 00 00 00 00 02 DD 03                        
			39 01 00 00 00 00 02 DE 2D                        
			39 01 00 00 00 00 02 DF 03                        
			39 01 00 00 00 00 02 E0 3C                        
			39 01 00 00 00 00 02 E1 03                        
			39 01 00 00 00 00 02 E2 4C                        
			39 01 00 00 00 00 02 E3 03                        
			39 01 00 00 00 00 02 E4 5E                        
			39 01 00 00 00 00 02 E5 03                        
			39 01 00 00 00 00 02 E6 71                        
			39 01 00 00 00 00 02 E7 03                        
			39 01 00 00 00 00 02 E8 89                        
			39 01 00 00 00 00 02 E9 03                        
			39 01 00 00 00 00 02 EA A5                        
			39 01 00 00 00 00 02 EB 03                        
			39 01 00 00 00 00 02 EC D5                        
			39 01 00 00 00 00 02 ED 03                        
			39 01 00 00 00 00 02 EE FF
			
			39 01 00 00 00 00 02 EF 00//G+                        
			39 01 00 00 00 00 02 F0 00                        
			39 01 00 00 00 00 02 F1 00                        
			39 01 00 00 00 00 02 F2 14                        
			39 01 00 00 00 00 02 F3 00                        
			39 01 00 00 00 00 02 F4 3A                        
			39 01 00 00 00 00 02 F5 00                        
			39 01 00 00 00 00 02 F6 5A                        
			39 01 00 00 00 00 02 F7 00                        
			39 01 00 00 00 00 02 F8 74                        
			39 01 00 00 00 00 02 F9 00                        
			39 01 00 00 00 00 02 FA 8B
			
			39 01 00 00 00 00 02 FB 01                                            
			39 01 00 00 00 00 02 FF 02                        
			39 01 00 00 00 00 02 00 00                        
			39 01 00 00 00 00 02 01 9F                        
			39 01 00 00 00 00 02 02 00                        
			39 01 00 00 00 00 02 03 B1                        
			39 01 00 00 00 00 02 04 00                        
			39 01 00 00 00 00 02 05 C2                        
			39 01 00 00 00 00 02 06 00                       
			39 01 00 00 00 00 02 07 F7                       
			39 01 00 00 00 00 02 08 01                       
			39 01 00 00 00 00 02 09 20                       
			39 01 00 00 00 00 02 0A 01                       
			39 01 00 00 00 00 02 0B 5C                       
			39 01 00 00 00 00 02 0C 01                       
			39 01 00 00 00 00 02 0D 89                       
			39 01 00 00 00 00 02 0E 01                       
			39 01 00 00 00 00 02 0F CB                       
			39 01 00 00 00 00 02 10 01                       
			39 01 00 00 00 00 02 11 FF                       
			39 01 00 00 00 00 02 12 02                       
			39 01 00 00 00 00 02 13 00                       
			39 01 00 00 00 00 02 14 02                       
			39 01 00 00 00 00 02 15 31                       
			39 01 00 00 00 00 02 16 02                       
			39 01 00 00 00 00 02 17 6F                       
			39 01 00 00 00 00 02 18 02                       
			39 01 00 00 00 00 02 19 9A                       
			39 01 00 00 00 00 02 1A 02                       
			39 01 00 00 00 00 02 1B D4                       
			39 01 00 00 00 00 02 1C 02                       
			39 01 00 00 00 00 02 1D FB                       
			39 01 00 00 00 00 02 1E 03                       
			39 01 00 00 00 00 02 1F 2D                       
			39 01 00 00 00 00 02 20 03                       
			39 01 00 00 00 00 02 21 3C                       
			39 01 00 00 00 00 02 22 03                       
			39 01 00 00 00 00 02 23 4C                       
			39 01 00 00 00 00 02 24 03                       
			39 01 00 00 00 00 02 25 5E                       
			39 01 00 00 00 00 02 26 03                       
			39 01 00 00 00 00 02 27 71                       
			39 01 00 00 00 00 02 28 03                       
			39 01 00 00 00 00 02 29 89                       
			39 01 00 00 00 00 02 2A 03                       
			39 01 00 00 00 00 02 2B A5                       
			39 01 00 00 00 00 02 2D 03                       
			39 01 00 00 00 00 02 2F D5                       
			39 01 00 00 00 00 02 30 03                       
			39 01 00 00 00 00 02 31 FF
			
			39 01 00 00 00 00 02 32 00 //G-                      
			39 01 00 00 00 00 02 33 00                       
			39 01 00 00 00 00 02 34 00                       
			39 01 00 00 00 00 02 35 14                       
			39 01 00 00 00 00 02 36 00                       
			39 01 00 00 00 00 02 37 3A                       
			39 01 00 00 00 00 02 38 00                       
			39 01 00 00 00 00 02 39 5A                       
			39 01 00 00 00 00 02 3A 00                       
			39 01 00 00 00 00 02 3B 74                       
			39 01 00 00 00 00 02 3D 00                       
			39 01 00 00 00 00 02 3F 8B                       
			39 01 00 00 00 00 02 40 00                       
			39 01 00 00 00 00 02 41 9F                       
			39 01 00 00 00 00 02 42 00                       
			39 01 00 00 00 00 02 43 B1                       
			39 01 00 00 00 00 02 44 00                       
			39 01 00 00 00 00 02 45 C2                       
			39 01 00 00 00 00 02 46 00                       
			39 01 00 00 00 00 02 47 F7                       
			39 01 00 00 00 00 02 48 01                       
			39 01 00 00 00 00 02 49 20                       
			39 01 00 00 00 00 02 4A 01                       
			39 01 00 00 00 00 02 4B 5C                       
			39 01 00 00 00 00 02 4C 01                       
			39 01 00 00 00 00 02 4D 89                       
			39 01 00 00 00 00 02 4E 01                       
			39 01 00 00 00 00 02 4F CB                       
			39 01 00 00 00 00 02 50 01                       
			39 01 00 00 00 00 02 51 FF                       
			39 01 00 00 00 00 02 52 02                       
			39 01 00 00 00 00 02 53 00                       
			39 01 00 00 00 00 02 54 02                       
			39 01 00 00 00 00 02 55 31                       
			39 01 00 00 00 00 02 56 02                       
			39 01 00 00 00 00 02 58 6F                       
			39 01 00 00 00 00 02 59 02                       
			39 01 00 00 00 00 02 5A 9A                       
			39 01 00 00 00 00 02 5B 02                       
			39 01 00 00 00 00 02 5C D4                       
			39 01 00 00 00 00 02 5D 02                       
			39 01 00 00 00 00 02 5E FB                       
			39 01 00 00 00 00 02 5F 03                       
			39 01 00 00 00 00 02 60 2D                       
			39 01 00 00 00 00 02 61 03                       
			39 01 00 00 00 00 02 62 3C                       
			39 01 00 00 00 00 02 63 03                       
			39 01 00 00 00 00 02 64 4C                       
			39 01 00 00 00 00 02 65 03                       
			39 01 00 00 00 00 02 66 5E                       
			39 01 00 00 00 00 02 67 03                       
			39 01 00 00 00 00 02 68 71                       
			39 01 00 00 00 00 02 69 03                       
			39 01 00 00 00 00 02 6A 89                       
			39 01 00 00 00 00 02 6B 03                       
			39 01 00 00 00 00 02 6C A5                       
			39 01 00 00 00 00 02 6D 03                       
			39 01 00 00 00 00 02 6E D5                       
			39 01 00 00 00 00 02 6F 03                       
			39 01 00 00 00 00 02 70 FF
			
			39 01 00 00 00 00 02 71 00 //B+                      
			39 01 00 00 00 00 02 72 00                       
			39 01 00 00 00 00 02 73 00                       
			39 01 00 00 00 00 02 74 14                       
			39 01 00 00 00 00 02 75 00                       
			39 01 00 00 00 00 02 76 3A                       
			39 01 00 00 00 00 02 77 00                       
			39 01 00 00 00 00 02 78 5A                       
			39 01 00 00 00 00 02 79 00                       
			39 01 00 00 00 00 02 7A 74                       
			39 01 00 00 00 00 02 7B 00                       
			39 01 00 00 00 00 02 7C 8B                       
			39 01 00 00 00 00 02 7D 00                       
			39 01 00 00 00 00 02 7E 9F                       
			39 01 00 00 00 00 02 7F 00                       
			39 01 00 00 00 00 02 80 B1                       
			39 01 00 00 00 00 02 81 00                       
			39 01 00 00 00 00 02 82 C2                       
			39 01 00 00 00 00 02 83 00                       
			39 01 00 00 00 00 02 84 F7                       
			39 01 00 00 00 00 02 85 01                       
			39 01 00 00 00 00 02 86 20                       
			39 01 00 00 00 00 02 87 01                       
			39 01 00 00 00 00 02 88 5C                       
			39 01 00 00 00 00 02 89 01                       
			39 01 00 00 00 00 02 8A 89                       
			39 01 00 00 00 00 02 8B 01                       
			39 01 00 00 00 00 02 8C CB                       
			39 01 00 00 00 00 02 8D 01                       
			39 01 00 00 00 00 02 8E FF                       
			39 01 00 00 00 00 02 8F 02                       
			39 01 00 00 00 00 02 90 00                       
			39 01 00 00 00 00 02 91 02                       
			39 01 00 00 00 00 02 92 31                       
			39 01 00 00 00 00 02 93 02                       
			39 01 00 00 00 00 02 94 6F                       
			39 01 00 00 00 00 02 95 02                       
			39 01 00 00 00 00 02 96 9A                       
			39 01 00 00 00 00 02 97 02                       
			39 01 00 00 00 00 02 98 D4                       
			39 01 00 00 00 00 02 99 02                       
			39 01 00 00 00 00 02 9A FB                       
			39 01 00 00 00 00 02 9B 03                       
			39 01 00 00 00 00 02 9C 2D                       
			39 01 00 00 00 00 02 9D 03                       
			39 01 00 00 00 00 02 9E 3C                       
			39 01 00 00 00 00 02 9F 03                       
			39 01 00 00 00 00 02 A0 4C                        
			39 01 00 00 00 00 02 A2 03                        
			39 01 00 00 00 00 02 A3 5E                        
			39 01 00 00 00 00 02 A4 03                        
			39 01 00 00 00 00 02 A5 71                        
			39 01 00 00 00 00 02 A6 03                        
			39 01 00 00 00 00 02 A7 89                        
			39 01 00 00 00 00 02 A9 03                        
			39 01 00 00 00 00 02 AA A5                        
			39 01 00 00 00 00 02 AB 03                        
			39 01 00 00 00 00 02 AC D5                        
			39 01 00 00 00 00 02 AD 03                        
			39 01 00 00 00 00 02 AE FF
			
			39 01 00 00 00 00 02 AF 00//B-                       
			39 01 00 00 00 00 02 B0 00                        
			39 01 00 00 00 00 02 B1 00                        
			39 01 00 00 00 00 02 B2 14                        
			39 01 00 00 00 00 02 B3 00                        
			39 01 00 00 00 00 02 B4 3A                        
			39 01 00 00 00 00 02 B5 00                        
			39 01 00 00 00 00 02 B6 5A                        
			39 01 00 00 00 00 02 B7 00                        
			39 01 00 00 00 00 02 B8 74                        
			39 01 00 00 00 00 02 B9 00                        
			39 01 00 00 00 00 02 BA 8B                        
			39 01 00 00 00 00 02 BB 00                        
			39 01 00 00 00 00 02 BC 9F                        
			39 01 00 00 00 00 02 BD 00                        
			39 01 00 00 00 00 02 BE B1                        
			39 01 00 00 00 00 02 BF 00                        
			39 01 00 00 00 00 02 C0 C2                        
			39 01 00 00 00 00 02 C1 00                        
			39 01 00 00 00 00 02 C2 F7                        
			39 01 00 00 00 00 02 C3 01                        
			39 01 00 00 00 00 02 C4 20                        
			39 01 00 00 00 00 02 C5 01                        
			39 01 00 00 00 00 02 C6 5C                        
			39 01 00 00 00 00 02 C7 01                        
			39 01 00 00 00 00 02 C8 89                        
			39 01 00 00 00 00 02 C9 01                        
			39 01 00 00 00 00 02 CA CB                        
			39 01 00 00 00 00 02 CB 01                        
			39 01 00 00 00 00 02 CC FF                        
			39 01 00 00 00 00 02 CD 02                        
			39 01 00 00 00 00 02 CE 00                        
			39 01 00 00 00 00 02 CF 02                        
			39 01 00 00 00 00 02 D0 31                        
			39 01 00 00 00 00 02 D1 02                        
			39 01 00 00 00 00 02 D2 6F                        
			39 01 00 00 00 00 02 D3 02                        
			39 01 00 00 00 00 02 D4 9A                        
			39 01 00 00 00 00 02 D5 02                        
			39 01 00 00 00 00 02 D6 D4                        
			39 01 00 00 00 00 02 D7 02                        
			39 01 00 00 00 00 02 D8 FB                        
			39 01 00 00 00 00 02 D9 03                        
			39 01 00 00 00 00 02 DA 2D                        
			39 01 00 00 00 00 02 DB 03                        
			39 01 00 00 00 00 02 DC 3C                        
			39 01 00 00 00 00 02 DD 03                        
			39 01 00 00 00 00 02 DE 4C                        
			39 01 00 00 00 00 02 DF 03                        
			39 01 00 00 00 00 02 E0 5E                        
			39 01 00 00 00 00 02 E1 03                        
			39 01 00 00 00 00 02 E2 71                        
			39 01 00 00 00 00 02 E3 03                        
			39 01 00 00 00 00 02 E4 89                        
			39 01 00 00 00 00 02 E5 03                        
			39 01 00 00 00 00 02 E6 A5                        
			39 01 00 00 00 00 02 E7 03                        
			39 01 00 00 00 00 02 E8 D5                        
			39 01 00 00 00 00 02 E9 03                        
			39 01 00 00 00 00 02 EA FF
			
			39 01 00 00 00 00 02 FB 01                        
			39 01 00 00 00 00 02 FF 00                        
			39 01 00 00 00 00 02 D3 06                        
			39 01 00 00 00 00 02 D4 04                        
			39 01 00 00 00 00 02 35 00                        
			39 01 00 00 78 00 02 11 00                        
			39 01 00 00 3a 00 02 29 00 ];
		qcom,mdss-dsi-off-command = [05  01  00  00  32  00  02  28  00 
					05  01  00  00  78  00  02  10  00];
		qcom,mdss-dsi-on-command-state = "dsi_lp_mode";
		qcom,mdss-dsi-off-command-state = "dsi_hs_mode";
		qcom,mdss-dsi-h-sync-pulse = <1>;
		qcom,mdss-dsi-traffic-mode = "burst_mode";
		qcom,mdss-dsi-lane-map = "lane_map_0123";
		qcom,mdss-dsi-bllp-eof-power-mode;
		qcom,mdss-dsi-bllp-power-mode;
		qcom,mdss-dsi-lane-0-state;
		qcom,mdss-dsi-lane-1-state;
		qcom,mdss-dsi-lane-2-state;
		qcom,mdss-dsi-lane-3-state;
		qcom,mdss-dsi-panel-timings = [f9 3d 34 00 58 4d 36 3f 53 03 04 00];
		qcom,mdss-dsi-t-clk-post = <0x1e>;
		qcom,mdss-dsi-t-clk-pre = <0x38>;
		qcom,mdss-dsi-bl-min-level = <1>;
		qcom,mdss-dsi-bl-max-level = <4095>;
		qcom,mdss-dsi-dma-trigger = "trigger_sw";
		qcom,mdss-dsi-mdp-trigger = "none";
		qcom,mdss-dsi-bl-pmic-control-type = "bl_ctrl_pwm";
		qcom,mdss-dsi-bl-pmic-pwm-frequency = <50>;
		qcom,mdss-dsi-bl-pmic-bank-select = <0>;
		qcom,mdss-dsi-pwm-gpio = <&pm8937_mpps 4 0>;
		qcom,mdss-dsi-reset-sequence = <1 20>, <0 20>, <1 20>; 
		qcom,cont-splash-enabled;
		qcom,panel-supply-entries = <&dsi_panel_pwr_supply>;		
	};
};
