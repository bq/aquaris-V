/* Copyright (c) 2015-2016, The Linux Foundation. All rights reserved.
 *
 * This program is free software; you can redistribute it and/or modify
 * it under the terms of the GNU General Public License version 2 and
 * only version 2 as published by the Free Software Foundation.
 *
 * This program is distributed in the hope that it will be useful,
 * but WITHOUT ANY WARRANTY; without even the implied warranty of
 * MERCHANTABILITY or FITNESS FOR A PARTICULAR PURPOSE.  See the
 * GNU General Public License for more details.
 */

&mdss_mdp {
	dsi_truly_r63350_1080p_video: qcom,mdss_dsi_truly_r63350_1080p_video {
		qcom,mdss-dsi-panel-name = "truly r63350 1080p video mode dsi panel";
		qcom,mdss-dsi-panel-controller = <&mdss_dsi0>;
		qcom,mdss-dsi-panel-type = "dsi_video_mode";
		qcom,mdss-dsi-panel-destination = "display_1";
		qcom,mdss-dsi-panel-framerate = <60>;
		qcom,mdss-dsi-virtual-channel-id = <0>;
		qcom,mdss-dsi-stream = <0>;
		qcom,mdss-dsi-panel-width = <1080>;
		qcom,mdss-dsi-panel-height = <1920>;
		qcom,mdss-dsi-h-front-porch = <108>;
		qcom,mdss-dsi-h-back-porch = <64>;
		qcom,mdss-dsi-h-pulse-width = <20>;
		qcom,mdss-dsi-h-sync-skew = <0>;
		qcom,mdss-dsi-v-front-porch = <9>;
		qcom,mdss-dsi-v-back-porch = <4>;
		qcom,mdss-dsi-v-pulse-width = <2>;
		qcom,mdss-dsi-h-left-border = <0>;
		qcom,mdss-dsi-h-right-border = <0>;
		qcom,mdss-dsi-v-top-border = <0>;
		qcom,mdss-dsi-v-bottom-border = <0>;
		qcom,mdss-dsi-bpp = <24>;
		qcom,mdss-dsi-color-order = "rgb_swap_rgb";
		qcom,mdss-dsi-underflow-color = <0xff>;
		qcom,mdss-dsi-border-color = <0>;
		qcom,mdss-dsi-on-command = [
			29 01 00 00 00 00 02 B0 00
			29 01 00 00 00 00 02 D6 01
			29 01 00 00 00 00 07 B3 14 00 00 00 00 00
			29 01 00 00 00 00 03 B4 0C 00
			29 01 00 00 00 00 04 B6 4B DB 16
			29 01 00 00 00 00 03 BE 00 04
			29 01 00 00 00 00 02 C0 00
			29 01 00 00 00 00 23 C1 04 60 00 20 A9 30 20 63 F0 FF FF 9B 7B CF B5 FF FF 87 8C 41 22 54 02 00 00 00 00 00 22 33 03 22 00 FF
			29 01 00 00 00 00 09 C2 31 f7 80 06 04 00 00 08
			29 01 00 00 00 00 04 C3 00 00 00
			29 01 00 00 00 00 0c C4 70 00 00 44 44 44 44 44 44 00 02
			29 01 00 00 00 00 02 C5 00
			29 01 00 00 00 00 16 C6 C8 3C 3C 07 01 07 01 00 00 00 00 00 00 00 00 00 00 0E 1A 07 C8
			29 01 00 00 00 00 1f C7 03 13 1D 28 39 46 4E 5B 3D 45 52 5F 68 6D 72 01 13 1D 28 39 46 4E 5B 3D 45 52 5F 68 6D 78
			29 01 00 00 00 00 10 CB FF E1 87 FF 00 00 00 00 FF E1 87 FF E8 00 00
			29 01 00 00 00 00 02 CC 34
			29 01 00 00 00 00 0b D0 11 00 00 56 D5 40 19 19 09 00
			29 01 00 00 00 00 05 D1 00 48 16 0F
			29 01 00 00 00 00 04 D2 5C 00 00
			29 01 00 00 00 00 1b D3 1B 33 BB BB B3 33 33 33 33 00 01 00 00 D8 A0 0C 4D 4D 33 33 72 12 8A 57 3D BC
			29 01 00 00 00 00 04 D8 00 00 00
			29 01 00 00 00 00 04 D9 00 00 00
			15 01 00 00 00 00 02 35 00
			15 01 00 00 00 00 02 51 ff
			15 01 00 00 00 00 02 53 24
			15 01 00 00 00 00 02 55 00
			05 01 00 00 32 00 02 29 00
			05 01 00 00 78 00 02 11 00];
		qcom,mdss-dsi-off-command = [
				 05 01 00 00 14 00 02 28 00
				 29 01 00 00 00 00 02 B0 04
				 29 01 00 00 00 00 1B D3 13 33 BB B3 B3 33 33 33 33 00 01 00 00 F8 A0 06 5F 5F 33 33 72 12 8a 57 3D BC
				 05 01 00 00 78 00 02 10 00
				 29 01 00 00 00 00 02 B0 00
				 29 01 00 00 14 00 02 B1 01];
		qcom,mdss-dsi-on-command-state = "dsi_lp_mode";
		qcom,mdss-dsi-off-command-state = "dsi_hs_mode";
		qcom,mdss-dsi-h-sync-pulse = <1>;
		qcom,mdss-dsi-traffic-mode = "burst_mode";
		qcom,mdss-dsi-lane-map = "lane_map_0123";
		qcom,mdss-dsi-bllp-eof-power-mode;
		qcom,mdss-dsi-bllp-power-mode;
		qcom,mdss-dsi-lane-0-state;
		qcom,mdss-dsi-lane-1-state;
		qcom,mdss-dsi-lane-2-state;
		qcom,mdss-dsi-lane-3-state;
		qcom,mdss-dsi-panel-timings = [E6 38 26 00 68 6C 2A 3A 2C 03 04 00];
		qcom,mdss-dsi-t-clk-post = <0x02>;
		qcom,mdss-dsi-t-clk-pre = <0x2B>;
		qcom,mdss-pan-physical-width-dimension = <68>;
		qcom,mdss-pan-physical-height-dimension = <121>;
		qcom,mdss-dsi-bl-min-level = <1>;
		qcom,mdss-dsi-bl-max-level = <4095>;
		qcom,mdss-dsi-dma-trigger = "trigger_sw";
		qcom,mdss-dsi-mdp-trigger = "none";
		qcom,mdss-dsi-bl-pmic-control-type = "bl_ctrl_pwm";
		qcom,mdss-dsi-bl-pmic-pwm-frequency = <50>;
		qcom,mdss-dsi-bl-pmic-bank-select = <0>;
		qcom,mdss-dsi-pwm-gpio = <&pm8937_mpps 4 0>;
		qcom,mdss-dsi-reset-sequence = <1 20>, <0 20>, <1 20>;
		qcom,cont-splash-enabled;
		qcom,panel-supply-entries = <&dsi_panel_pwr_supply>;
		qcom,mdss-dsi-lp11-init;
		qcom,mdss-dsi-init-delay-us = <100>;		
		qcom,esd-check-enabled;
		qcom,mdss-dsi-tx-eot-append;
		qcom,mdss-dsi-panel-status-command = [06 01 00 01 05 00 01 0A];
		qcom,mdss-dsi-panel-status-command-mode = "dsi_lp_mode";
		qcom,mdss-dsi-panel-status-check-mode = "reg_read";
		qcom,mdss-dsi-panel-status-read-length = <1>;
		qcom,mdss-dsi-panel-status-value = <0x1C>;
		qcom,mdss-dsi-panel-max-error-count = <3>;
	};
};
