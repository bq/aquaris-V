/*
 * Copyright (c) 2016, The Linux Foundation. All rights reserved.
 *
 * This program is free software; you can redistribute it and/or modify
 * it under the terms of the GNU General Public License version 2 and
 * only version 2 as published by the Free Software Foundation.
 *
 * This program is distributed in the hope that it will be useful,
 * but WITHOUT ANY WARRANTY; without even the implied warranty of
 * MERCHANTABILITY or FITNESS FOR A PARTICULAR PURPOSE.  See the
 * GNU General Public License for more details.
 */

/dts-v1/;

#include "msm8940-pmi8950-bq-common.dtsi"

/ {
	model = "Qualcomm Technologies, Inc. MSM8940-PMI8950 QRD SKU7";
	compatible = "qcom,msm8940-qrd-sku7", "qcom,msm8940-qrd",
		   "qcom,msm8940", "qcom,qrd";
	qcom,board-id= <0x1000b 0x80>;
	qcom,pmic-id = <0x10019 0x010011 0x0 0x0>;
};

&pmi8950_charger {
	qcom,thermal-mitigation = <2600 2300 1800 1400 900 700 0>;
};
/ {
	qrd_batterydata: qcom,battery-data {
		qcom,batt-id-range-pct = <15>;
		#include "batterydata-qrd-jiade-4v4-3000mah.dtsi"
		#include "batterydata-qrd-veken-4v4-3000mah.dtsi"
		//#include "batterydata-qrd-sku2-4v35-2590mah.dtsi"
	};
};
